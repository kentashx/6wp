#include <Adafruit_NeoPixel.h>

/**********************************************
＊プログラム概要説明
脈拍を計測時間中は、計測。（デフォルトは10秒）
１０秒後、bpm_delayを算出し、その後はそのテンポで鳴らし続ける。
音は、テキストデータとして格納

＊課題
計測時間の妥当性。
**********************************************/
const unsigned char dram_raw[] PROGMEM = {
  0x3e, 0x42, 0x43, 0x41, 0x44, 0x45, 0x46, 0x4a, 0x4d, 0x52, 0x5a, 0x5e,
  0x64, 0x72, 0x76, 0x73, 0x6d, 0x6e, 0x6c, 0x67, 0x60, 0x5f, 0x64, 0x68,
  0x69, 0x66, 0x65, 0x63, 0x68, 0x6c, 0x70, 0x70, 0x6d, 0x71, 0x74, 0x72,
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  0x7a, 0x7a, 0x7b, 0x7b, 0x7b, 0x7b, 0x7c, 0x7d
};
//MP3再生用変数
unsigned int dram_raw_len =11096;//テキストデータの長さ
double temp = 1.0;//テンポ
int val = 0;
//脈拍用
//int analog_output = 0;
int digital_output = 5;//脈拍のデジタル値を読み込むのためのピン
static int seq_pulse = 0;//パルスの連続個数
int pulse = 0;//パルスの検出値
double bpm =0.0;//計測したbpm値
int bpm_flag = 0;//bpmの計算を一回にするためのフラグ
int bpm_delay = 1000;//bpm値に基づくdelay
static double one_loop_time =0.0;//1ループの時間
static int measure_time = 10000;//計測時間(ミリ秒)
static int flag =0;//1ループを計測するためのフラグ

//ボタン用
//boolean start_button_flag =  0;//0でstop、１でstart
//boolean button_flag =  0;//0は無効、1でreset
int button_flag = 0;// トグル:どの切り替えがされているかが格納
int toggle = 13;//トグルピンを読み込むピン
static long start_time = 0;//処理開始時間
static long start_time_flag = 0;//処理開始判定。0の時は処理行われず。1の時は処理開始。
static int SW =13;
static int PUSH_SHORT = 70;//ショートボタンの閾値
static int PUSH_LONG = 1000;//ロングボタンの閾値
boolean button = 0;

//neopixcel用
#define PIN            10 //シリアル通信GPIOピン番号
#define MAXPIXELS      12 //LED素子の最大数
Adafruit_NeoPixel pixels = Adafruit_NeoPixel(MAXPIXELS, PIN, NEO_GRB + NEO_KHZ800);

//neopixcel_loading用
uint8_t LedNum1_Inc = 9; //最初にフェードインするLED番号
uint8_t LedNum1_Dec = 8; //フェードアウトするLED番号
 
uint8_t ChangeType = 3; //LED点灯パターンを決める引数
uint32_t ChangeTime; //LED点灯パターンを変える時間
int cnt = 0; //256段階でLEDをフェードさせるためのカウント
//リセットする関数 
void software_reset(){
  asm volatile (" jmp 0");
  start_time_flag = 0;
}

//ボタンを検出する関数
//ボタンを検出する関数
/*void detect_button(){
  unsigned long gauge_time = 0;
  static unsigned long gauge_time_start = 0;
  static unsigned long gauge_time_flag = 0;
  //HIGHになってる時間を検出
  while (!digitalRead(SW))
  {
    if(gauge_time_flag == 0){
      gauge_time_start = millis();
      gauge_time_flag = 1;
    }
    gauge_time = millis() - gauge_time_start;
  }
//HIGHの連続時間により短い押し、長い押しを判断
 if(gauge_time>PUSH_LONG){
    Serial.print("reset!!!!");
    Serial.print(":");
    Serial.print(gauge_time);
    Serial.print("  LONG!");
    Serial.println();
    button_flag = 1;
    gauge_time_flag = 0;
  } 
  else if(gauge_time>PUSH_SHORT){
    start_button_flag = !start_button_flag;
    Serial.print(start_button_flag);
    Serial.print(":");
    Serial.print(gauge_time);
    Serial.print("  SHORT!");
    Serial.println();
    gauge_time_flag = 0;
    if(start_time_flag==0){
      Serial.println("はじめ");
      start_time = millis();
      start_time_flag =start_time_flag+1;
    }
  } 
  gauge_time = 0;
  gauge_time_start=0;
  gauge_time_flag = 0;
}
*/
//bpm値を検出する関数
void bpm_pulse(){
    if(bpm_flag==0){
      bpm = seq_pulse*60/(measure_time/1000);
      bpm_delay = 60000/bpm;
      bpm_flag = bpm_flag+1;
  }
}

//ON-OFF-ONのトグルスイッチの切り替えによって動作を変える
void detect_toggle_button(){
  int old_old_val = 0;//チャタリング用
  int old_val = 0;//チャタリング用
  int val = 0;
  old_old_val = digitalRead(toggle);
  delay(5);
  old_val = digitalRead(toggle);
  delay(5);
  val = digitalRead(toggle);
  if((old_old_val==0)&&(old_val==0)&&(val==0)){
    button_flag=0;
  }
  else{
    button_flag=1;
  }
}

//pulseを検出する関数
void detect_pulse(){
  static int old_detect_val = 0;
  static int seq_count =0;//パルスの連続回数
  static int thresh_hold =100;//ノイズ除去時間
  static int high_time_start = 0;//ノイズ除去用の時間
  static int high_time_total = 0;
  static int detect_val = 0;
  Serial.println(seq_pulse);
//detect_val =analogRead(analog_output);
  detect_val = digitalRead(digital_output);
//HIGHの立ち上がりの時間を検出,HIGHになっている時間を検出
  if(old_detect_val==0){
    if(detect_val==1){
      high_time_start = millis();
     }
  }
  else if(detect_val==1){
    high_time_total = millis() - high_time_start;
  }
  else{
    high_time_total = 0;
    high_time_start = 0;
  }
//HIGHの連続値が閾値を超えた時，パルス出力
  if(high_time_total>thresh_hold){
    //Serial.println(high_time_start);
    pulse=1;
    seq_pulse = seq_pulse+1;
    delay(100);
  } 
  else{
    pulse=0;
  }
  old_detect_val = detect_val;
}

//最後にパルス値を出力する関数
void pulse_info(){
  static int pulse_flag = 0;
  if (pulse_flag==0){
    Serial.print("bpmは");
    Serial.println(bpm);
    Serial.print("bpm_dalayは");
    Serial.println(bpm_delay);
    Serial.print("1ループにかかる時間は");
    Serial.print(one_loop_time/100);
    Serial.println("msです");
    Serial.print("終了時間は");
    Serial.print(millis());
    Serial.println("msです");
    Serial.print("検出パルス数は");
    Serial.print(seq_pulse);
    Serial.println("個です");
    Serial.print("開始時間は");
    Serial.print(start_time);
    Serial.println("msです");
    Serial.println("END");
    pulse_flag = pulse_flag + 1;
  }
}

//1ループにかかる時間を検出
void loop_time() {
  //delay(5000);//脈拍が安定するまでの5秒間は待つ
  flag=flag+1;
  if(flag==2){
   Serial.println("はじめ");
  }
  if(flag==100){
    one_loop_time =millis();
    flag = flag+1;
  }
}

//脈拍検知用
void led_loading(){
      
      pixels.setPixelColor(LedNum1_Inc, pixels.Color(0, cnt, 30));
      pixels.show();
      pixels.setPixelColor(LedNum1_Dec, pixels.Color(0,255-cnt, 30));
      pixels.show();

      cnt = cnt+1;

      if(cnt == 256){ //フェードが最大、最少になったらLED素子を変える
        LedNum1_Inc++;
        if(LedNum1_Inc >= 12){ 
        LedNum1_Inc = 0;
        }
        LedNum1_Dec++;
        if(LedNum1_Dec >= 12) LedNum1_Dec = 0;
        cnt = 0;
       }
}

void setup() {
  Serial.begin(9600);
  pixels.begin(); // This initializes the NeoPixel library.
  pixels.setBrightness(255); //Max 255.power of bllitness
  pinMode(3,OUTPUT);
  pinMode(SW, INPUT_PULLUP);
  TCCR2A = _BV(COM2B1) | _BV(WGM21) | _BV(WGM20);
  TCCR2B = _BV(CS20);

}

void play() {
  for (int i =0; i<dram_raw_len;i++){
    OCR2B =pgm_read_byte_near(&dram_raw[i]);
    delayMicroseconds(25);
  }
}

void loop(){
  detect_toggle_button();
  led_loading();
  if(button_flag==0){
    Serial.print("reset!!!!");
    delay(1000);
    software_reset();
  }
  else if(button_flag == 1){
    if((millis() - start_time)<measure_time){
      //Serial.println("はじめ");
      detect_pulse();
      loop_time();//チェック用
    }
    else{
    //Serial.println("後半");
    bpm_pulse();
    pulse_info();
    play();
    delay(bpm_delay);
    }
  }
}


